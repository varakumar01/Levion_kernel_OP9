## arch/arm64/configs/vendor/nethunter_defconfig
```kconfig
#Modules
CONFIG_MODULE_FORCE_LOAD=y
CONFIG_MODULE_FORCE_UNLOAD=y
#Bluetooth
CONFIG_BT_HCIBTUSB=y
CONFIG_BT_HCIBTUSB_BCM=y
CONFIG_BT_HCIBTUSB_RTL=y
CONFIG_BT_HCIUART=y
CONFIG_BT_HCIUART_H4=y
CONFIG_BT_HCIBCM203X=y
CONFIG_BT_HCIBPA10X=y
CONFIG_BT_HCIBFUSB=y
CONFIG_BT_HCIVHCI=y
#MAC80211
#Wireless LAN (WIFI Configs)
CONFIG_WLAN_VENDOR_ATH=y
CONFIG_ATH9K_HTC=y
CONFIG_CARL9170=y
CONFIG_ATH6KL=y
CONFIG_ATH6KL_USB=y
CONFIG_WLAN_VENDOR_MEDIATEK=y
CONFIG_MT7601U=y
CONFIG_WLAN_VENDOR_RALINK=y
CONFIG_RT2X00=y
CONFIG_RT2500USB=y
CONFIG_RT73USB=y
CONFIG_RT2800USB=y
CONFIG_RT2800USB_RT33XX=y
CONFIG_RT2800USB_RT35XX=y
CONFIG_RT2800USB_RT3573=y
CONFIG_RT2800USB_RT53XX=y
CONFIG_RT2800USB_RT55XX=y
CONFIG_RT2800USB_UNKNOWN=y
CONFIG_WLAN_VENDOR_REALTEK=y
CONFIG_RTL8187=y
CONFIG_RTL_CARDS=y
CONFIG_RTL8XXXU=y
CONFIG_RTL8XXXU_UNTESTED=y
CONFIG_USB_NET_RNDIS_WLAN=y
CONFIG_USB_CONFIGFS_OBEX=y
CONFIG_USB_CONFIGFS_ECM=y
CONFIG_USB_CONFIGFS_ECM_SUBSET=y
CONFIG_USB_CONFIGFS_RNDIS=y
CONFIG_USB_CONFIGFS_EEM=y

# SDR Support
CONFIG_MEDIA_DIGITAL_TV_SUPPORT=y
CONFIG_MEDIA_SDR_SUPPORT=y
CONFIG_MEDIA_SUBDRV_AUTOSELECT=y
CONFIG_USB_MSI2500=y
CONFIG_USB_HACKRF=y
CONFIG_USB_AIRSPY=y
# NFS Client Support
CONFIG_NFS_FS=m
CONFIG_NFS_V2=m
CONFIG_NFS_V3=y
CONFIG_NFS_V4=y
CONFIG_NFS_V4_1=y
CONFIG_NFS_V4_2=y
CONFIG_SUNRPC=m
CONFIG_SUNRPC_GSS=m
CONFIG_LOCKD=m

# CAN Bus Support — Bisect round 2: bare minimum
CONFIG_CAN=y

# Networking extras
CONFIG_VSOCKETS=y
CONFIG_NETLINK_DIAG=y

## USB Serial Adapters
#CONFIG_USB_SERIAL=m
#CONFIG_USB_SERIAL_GENERIC=m
#CONFIG_USB_SERIAL_CH341=m
#CONFIG_USB_SERIAL_FTDI_SIO=m
#CONFIG_USB_SERIAL_PL2303=m
```

## drivers/net/can/usb-can-2-module/Kconfig
```kconfig
config HLCAN
        tristate "hlcan module for usb-can"
        depends on USB
        default y
        help
          Help message of hlcan
```

## drivers/net/wireless/realtek/rtw88/Kconfig
```kconfig
# SPDX-License-Identifier: GPL-2.0-only
config RTW88
	tristate "Realtek 802.11ac wireless chips support"
	depends on MAC80211
	depends on NETHUNTER_SUPPORT
	default y
	help
	  This module adds support for mac80211-based wireless drivers that
	  enables Realtek IEEE 802.11ac wireless chipsets.

	  If you choose to build a module, it'll be called rtw88.
```

## drivers/staging/stealth/Kconfig
```kconfig
# SPDX-License-Identifier: GPL-2.0-only
config STEALTH_NET
	tristate "Stealth In-Kernel DNS/SNI Engine"
	depends on NETFILTER && INET && CRYPTO
	select CRYPTO_AES
	select CRYPTO_ECB
	select CRYPTO_GCM
	select CRYPTO_HMAC
	select CRYPTO_SHA256
	default y
	help
	  In-kernel network inspector and modifier.
	  Provides stealth DNS blocking, spoofing, and TLS SNI audit.
	  Includes /proc/stealth_dns and /proc/stealth_events interfaces.

	  If unsure, say Y.
```
